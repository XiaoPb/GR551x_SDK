## Kconfig.gr5xxx
```kconfig
menu "Basic configuration"

config APPLICATION_NAME
    string "Application Project Name"
    default "gr_sdk_temp"

config GR5515_SOC
    bool "GR5515 Chip"
    default y
    default n if CHIP_SOC=0

config GR5513_SOC
    bool "GR5513 Chip"
    default n
    default y if CHIP_SOC=0 && CHIP_TYPE>5

config GR5525_SOC
    bool "GR5525 Chip"
    default n
    default y if CHIP_SOC=1

config GR5526_SOC
    bool "GR5526 Chip"
    default n
    default y if CHIP_SOC=2

config GR533X_SOC
    bool "GR533X Chip"
    default n
    default y if CHIP_SOC=3

config GR5405_SOC
    bool "GR5405 Chip"
    default n
    default y if CHIP_SOC=4

config CHIP_SOC
    int "Chip version"
    default 0
    range 0 4
    help
      0 -> GR551X
      1 -> GR5525
      2 -> GR5526
      3 -> GR533X
      4 -> GR5405

if CHIP_SOC=0

config CHIP_TYPE
    int "GR5515 Chip version"
    default 4
    range 0 7
    help
      0=> GR5515IGND
      1=> GR5515IENDU
      2=> GR5515I0ND
      3=> GR5515I0NDA
      4=> GR5515RGBD
      5=> GR5515GGBD
      6=> GR5513BEND
      7=> GR5513BENDU

endif

if CHIP_SOC=3

config CHIP_TYPE
    int "GR533X Chip version"
    default 4
    range 0 4
    help
      0=> GR5330ACNI
      1=> GR5331AENI
      2=> GR5331CENI
      3=> GR5332AENE
      4=> GR5332CENE
      
endif

config ENCRYPT_ENABLE
    int "Enable encrypt chip"
    default 0
    range 0 1

config EXT_EXFLASH_ENABLE
    int "Enable the external flash of chip"
    default 0
    range 0 1

config PLATFORM_INIT_ENABLE
    int "Enable the platform initialization process"
    default 1
    range 0 1

config SYS_FAULT_TRACE_ENABLE
    int "Enable system fault trace module"
    default 1
    range 0 1

config ENABLE_BACKTRACE_FEA
    int "Enable callstack backtrace function"
    default 0
    range 0 1

config APP_DRIVER_USE_ENABLE
    int "Enable APP driver module"
    default 1
    range 0 1

config APP_LOG_ENABLE
    int "Eanble APP log module"
    default 1
    range 0 1

config APP_LOG_PORT
    int "APP log port type"
    range 0 2
    default 0
     0=> UART
     1=> RTT
     2=> ITM

config APP_LOG_STORE_ENABLE
    int "Eanble APP log store module"
    default 0
    range 0 1

if CHIP_TYPE=4

config SK_GUI_ENABLE
    int "Enable SK GUI module, only available in GR5515"
    default 1
    range 0 1

endif

config DEBUG_MONITOR
    int "Enable debug monitor module"
    default 0
    range 0 1

config DTM_TEST_ENABLE
    int "Enable DTM test support"
    default 0
    range 0 1

config FLASH_PROTECT_PRIORITY
    int "Protection priority level"
    default 0
    range 0 1

config NVDS_START_ADDR
    hex "NVDS Start Address"
    default 0x010FF000
    default 0x0107F000 if CHIP_TYPE=1 || CHIP_TYPE=6 || CHIP_TYPE=7

config NVDS_NUM_SECTOR
    int "The Number of sectors for NVDS"
    default 1
    range 1 16

config SYSTEM_STACK_SIZE
    hex "Call Stack Size"
    default 0x4000

config SYSTEM_HEAP_SIZE
    hex "Call Heap Size"
    default 0x1000

endmenu

menu "Boot info configuration"

config CHIP_VER
    hex "Chip version"
    default 0x5515
    help
      0x5515 -> GR551X
      0x5525 -> GR5525
      0x5526 -> GR5526
      0x5332 -> GR533X   

config APP_CODE_LOAD_ADDR
    hex "Code load address"
    default 0x01002000
    help
      0x30004100=> SRAM address
      0x01002000=> Flash address

config APP_CODE_RUN_ADDR
    hex "Code run address"
    default 0x01002000
    help
      0x30004100=> SRAM address
      0x01002000=> Flash address

config SYSTEM_CLOCK
    int "System clock"
    default 0
    help
      0=> 64MHZ
      1=> 48MHZ
      2=> 16MHZ-XO
      3=> 24MHZ
      4=> 16MHZ
      5=> 32MHZ-CPLL

config CFG_LF_ACCURACY_PPM
    int "External clock accuracy used in the LL to compute timing"
    default 500
    range 1 500

config CFG_LPCLK_INTERNAL_EN
    int "Enable internal osc as low power clock"
    default 0
    range 0 1
    help
      0=> Default: Disable internal osc as low power clock
      1=> Enable internal osc as low power clock and force CFG_LF_ACCURACY_PPM to 500ppm

config CFG_CRYSTAL_DELAY
    int "Delay time for Crystal stabilization time"
    default 100
    range 100 500

config BOOT_LONG_TIME
    int "Delay time for Boot startup"
    default 1
    range 0 1
    help
      0=> Not Delay
      1=> Delay 1s

config BOOT_CHECK_IMAGE
    int "In xip mode, check image during cold boot startup"
    default 1
    range 0 1
    help
      0=> Not check
      1=> Check image

config EXFLASH_WAKEUP_DELAY
    int "Delay time between flash wakeup and read chip id in warm boot"
    default 0
    range 0 10
    help
      0=>  No delay
      1=>  Delay 5 us
      2=>  Delay 10 us
      3=>  Delay 15 us
      4=>  Delay 20 us
      5=>  Delay 25 us
      6=>  Delay 30 us
      7=>  Delay 35 us
      8=>  Delay 40 us
      9=>  Delay 45 us
      10=> Delay 50 us


endmenu

menu "BLE resource configuration"

config CFG_MAX_PRFS
    int "Support maximum number of BLE profiles"
    default 10
    range 1 64

config CFG_MAX_BOND_DEVS
    int "Support maximum number of bonded devices"
    default 4

config CFG_SCAN_DUP_FILT_LIST_NUM
    int "Support the configuration of the number of scan duplicate filter lists"
    default 0
    range 0 50

config CFG_MAX_CONNECTIONS
    int "Support maximum number of BLE Links"
    default 5
    range 1 10

config CFG_MAX_ADVS
    int "Support maximum number of BLE Legacy/Extended Advertisings"
    default 1
    range 0 5

config CFG_MAX_ADV_DATA_LEN_SUPPORT
    int "Support 31 bytes adv data for legacy adv"
    default 0
    range 0 1
    help
      0=> NOT SUPPORT
      1=> SUPPORT

config CFG_MAX_PER_ADVS
    int "Support maximum number of BLE Periodic Advertisings"
    default 0
    range 0 5

config CFG_MAX_SYNCS
    int "Support maximum number of BLE Periodic Advertising Synchronizations"
    default 0
    range 0 5

config CFG_MAX_SCAN
    int "Support maximum number of BLE Scan"
    default 1
    range 0 1

config CFG_BT_BREDR
    int "Support BT-BR/EDR"
    default 0
    range 0 1
    help
      0=> NOT SUPPORT
      1=> SUPPORT

config CFG_MUL_LINK_WITH_SAME_DEV
    int "Support multiple link with the same device"
    default 0
    range 0 1
    help
      0=> NOT SUPPORT
      1=> SUPPORT

config CFG_CAR_KEY_SUPPORT
    int "Support car key needs"
    default 0
    range 0 1
    help
      0=> NOT SUPPORT
      1=> SUPPORT

config CFG_MAX_EATT_CHANNELS
    int "Support maximum number of BLE EATT Channels"
    default 0
    range 0 10

config CFG_ISO_SUPPORT
    int "Support ISO"
    default 0
    range 0 1
    help
      0=> NOT SUPPORT
      1=> SUPPORT

endmenu

menu "MESH support configuration"

config CFG_MESH_SUPPORT
    int "Support MESH"
    default 0
    range 0 1
    help
      0=> NOT SUPPORT
      1=> SUPPORT

endmenu

menu "LCP support configuration"

config CFG_LCP_SUPPORT
    int "Support LCP"
    default 0
    range 0 1
    help
      0=> NOT SUPPORT
      1=> SUPPORT 

endmenu

menu "Security configuration"

config SECURITY_CFG_VAL
    int "Algorithm security level"
    default 0
    range 0 1
    help
      0=> Enable algorithm level one
      1=> Enable algorithm level two

endmenu

source "components/Kconfig"
source "drivers/Kconfig"
source "external/Kconfig"
```

## components/Kconfig
```kconfig
source "components/drivers_ext/Kconfig"
source "components/libraries/Kconfig"
source "components/profiles/Kconfig"
```

## components/drivers_ext/Kconfig
```kconfig
menu "GR5xxx Drivers External"
config MEASURE_MUX_SIGNAL
    bool "gr5xxx measure mux signal"
	depends on ADC

config SPI_FLASH
    bool "gr5xxx spi flash"
	depends on SPI
    depends on QSPI

config TIM_DELAY
    bool "gr5xxx tim delay"
	depends on TIM

config ST7735_DRIVER
    bool "Apple Media Service Client"
	depends on SPI
endmenu
```

## components/libraries/Kconfig
```kconfig
menu "Libraries"

config APP_ALARM
    bool ""

config APP_ASSERT
    bool ""
    default y

config APP_CRYPTO
    bool ""

config APP_ERROR
    bool ""
    default y

config APP_KEY
    bool ""
    default y

config APP_LINKED_LIST
    bool ""

config APP_LOG
    bool ""
    default y

config APP_MEMORY
    bool ""

config APP_QUEUE
    bool ""

config APP_SCHEDULER
    bool ""

config APP_TIMER
    bool ""
    default y

config AT_CMD
    bool ""

config BLE
    bool ""

config CMSIS
    bool ""

config CRYPTO_LIB
    bool ""

config DFU_MASTER
    bool ""

config DFU_PORT
    bool ""

config FAULT_TRACE
    bool ""
    default y

config FCC
    bool ""

config GUI
    bool ""

config HAL_FLASH
    bool ""
    default y

config HCI_UART
    bool ""
    default n
    
config PMU_CALIBRATION
    bool ""
    default y

config RING_BUFFER
    bool ""
    default y

config SENSORSIM
    bool ""

config USER_EFUSE
    bool ""

config UTILITY
    bool ""
    default y

config VHCI
    bool ""
    

config VIRT_KEY
    bool ""


endmenu
```

## components/profiles/Kconfig
```kconfig
menu "Ble Profiles"
config AGS
    bool "Alexa Gadgets Service"
	depends on BLE_COMMON

config AMS_CLIENT
    bool "Apple Media Service Client"
	depends on BLE_COMMON

config ANCS_CLIENT
    bool "Apple Notification Center Service"
	depends on BLE_COMMON

config ANS
    bool "Alert Notification Service"
	depends on BLE_COMMON

config ANS_CLIENT
    bool "Alert Notification Service Client"
	depends on BLE_COMMON

config BAS
    bool "Battery Service"
	depends on BLE_COMMON

config BAS_CLIENT
    bool "Battery Service Client"
	depends on BLE_COMMON

config BCS
    bool "Body Composition Service"
	depends on BLE_COMMON

config BPS
    bool "Blood Pressure Service"
	depends on BLE_COMMON

config BLE_COMMON
    bool "Ble utils and types"
	default y

config CSCS
    bool "Cycling Speed and Cadence Service"
	depends on BLE_COMMON

config CTS
    bool "Current Time Service"
	depends on BLE_COMMON

config CTS_CLIENT
    bool "Current Time Service Client"
	depends on BLE_COMMON

config DIS
    bool "Device Information Service"
	depends on BLE_COMMON

config DIS_CLIENT
    bool "Device Information Service Client"
	depends on BLE_COMMON

config DSS
    bool "Device Synchronize Service"
	depends on BLE_COMMON

config GLS
    bool "Glucose Service"
	depends on BLE_COMMON

config GUS
    bool "Goodix UART Service"
	depends on BLE_COMMON

config GUS_CLIENT
    bool "Goodix UART Service Client"
	depends on BLE_COMMON

config HIDS
    bool "Human Interface Device Service"
	depends on BLE_COMMON

config HRRCPS
    bool "HRS RSCS Relay Control Point Service"
	depends on BLE_COMMON

config HRS
    bool "Heart Rate Service"
	depends on BLE_COMMON

config HRS_CLIENT
    bool "Heart Rate Service Client"
	depends on BLE_COMMON

config HTS
    bool "Health Thermometer Service"
	depends on BLE_COMMON

config IAS
    bool "Immediate Alarm Service"
	depends on BLE_COMMON

config IAS_CLIENT
    bool "Immediate Alert Service Client"
	depends on BLE_COMMON

config LLS
    bool "Link Loss Service"
	depends on BLE_COMMON

config LLS_CLIENT
    bool "Link Loss Service Client"
	depends on BLE_COMMON

config LMS
    bool "Log Management Service"
	depends on BLE_COMMON

config LNS
    bool "Log Notification Service"
	depends on BLE_COMMON

config MLMR
    bool "Multi Link Multi Role Service"
	depends on BLE_COMMON

config MLMR_CLIENT
    bool "Multi Link Multi Role Service Client"
	depends on BLE_COMMON

config NDCS
    bool "Next DST Change Service"
	depends on BLE_COMMON

config OTAS
    bool "Over The Air Service"
	depends on BLE_COMMON

config OTAS_CLIENT
    bool "Over The Air Service Client"
	depends on BLE_COMMON

config PASS
    bool "Phone Alert Status Service"
	depends on BLE_COMMON

config PASS_CLIENT
    bool "Phone Alert Status Service Client"
	depends on BLE_COMMON

config PCS
    bool "Power Consumption Service"
	depends on BLE_COMMON

config RSCS
    bool "Running Speed and Cadence Service"
	depends on BLE_COMMON

config RSCS_CLIENT
    bool "Running Speed and Cadence Service Client"
	depends on BLE_COMMON

config RTUS
    bool "Reference Time Update Service"
	depends on BLE_COMMON

config SAMPLE_SERVICE
    bool "Sample Service"
	depends on BLE_COMMON

config THS
    bool "Throughput Service"
	depends on BLE_COMMON

config THS_CLIENT
    bool "Throughput Client"
	depends on BLE_COMMON

config TPS
    bool "Tx Power Service"
	depends on BLE_COMMON

config TPS_CLIENT
    bool "Tx Power Service Client"
	depends on BLE_COMMON

config UDS
    bool "User Data Service"
	depends on BLE_COMMON

config WSS
    bool "Weight Scale Services"
	depends on BLE_COMMON
endmenu
```

## drivers/Kconfig
```kconfig
config ADC_DMA
    bool "Analog-to-Digital Converter (ADC) DMA drivers"
    default y
    depends on ADC
    select DMA

config ADC
    bool "Analog-to-Digital Converter (ADC) drivers"
    default n
    select GPIO
    
config AON_WDT
    bool "Watchdog drivers"
    default n
    
config BOD
    bool "BOD drivers"
    default n
    
config COMP
    bool "COMP drivers"
    default n
    
config DMA
    bool "Direct Memory Access (DMA) drivers"
    default n
    
config DUAL_TIM
    bool "Dual timer drivers"
    default n
    
config GRAPHICS_QSPI
    bool "Graphics qspi drivers"
    default n
    
config I2C_DMA
    bool "I2C DMA drivers"
    default y
    depends on I2C
    select DMA

config I2C
    bool "I2C drivers"
    default n
    select GPIO
    
config I2S_DMA
    bool "I2S DMA drivers"
    default y
    depends on I2S
    select DMA

config I2S
    bool "I2S drivers"
    default n
    select GPIO
    
config GPIO
    bool "GPIO drivers"
    default y
    
config ISO7816
    bool "ISO7816(SIM) Card drivers"
    
config PWM_DMA
    bool "PWM DMA drivers"
    default y
    depends on PWM
    select DMA

config PWM
    bool "PWM drivers"
    default n
    select GPIO

config PWR_MGMT
    bool "Pwr mgmt drivers"
    default y
    
config QSPI_DMA
    bool "QSPI DMA drivers"
    default y
    depends on QSPI
    select DMA    

config QSPI
    bool "QSPI drivers"
    default n
    select GPIO

config RNG
    bool "RNG drivers"
    default n
    
config RTC
    bool "RTC drivers"
    default n
    
config RTOS_CFG
    bool "RTOS config drivers"
    default n
    
config SOFT_ENCODER
    bool "Soft encoder drivers"
    default n
    
config SPI_DMA
    bool "SPI DMA drivers"
    default y
    depends on SPI
    select DMA

config SPI
    bool "SPI drivers"
    default n
    select GPIO

config TIM
    bool "Tim drivers"
    
config UART_DMA
    bool "UART DMA drivers"
    default y
    depends on UART
    select DMA

config UART
    bool "UART drivers"
    default y
    select GPIO
    
```
